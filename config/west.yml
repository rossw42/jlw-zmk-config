## config/west.yml
```yaml
manifest:
  remotes:
    - name: zmkfirmware
      url-base: https://github.com/zmkfirmware
    - name: jlw
      url-base: https://github.com/josh-l-wang
  projects:
    - name: zmk
      remote: zmkfirmware
      revision: v0.3
      import: app/west.yml
    - name: zmk-jlw-keyboards
      remote: jlw
      revision: main
  self:
    path: config
```
